## samples/application_development/stm32_hunk/boards/arm/stm32f103c8t6/Kconfig.board
```kconfig
# Kconfig - STM32 Minimum Development Board Configuration
#
# Copyright (c) 2017, embedjournal.com
#
# SPDX-License-Identifier: Apache-2.0
#
config BOARD_STM32F103C8T6
	bool "STM32F103C8T6 Development Board"
	depends on SOC_STM32F103X8
```

## samples/application_development/stm32_hunk/boards/arm/stm32f103c8t6/Kconfig.defconfig
```kconfig
# Kconfig - STM32 Minimum Development Board Configuration
#
# Copyright (c) 2017, embedjournal.com
#
# SPDX-License-Identifier: Apache-2.0
#

if BOARD_STM32F103C8T6

config BOARD
	default "stm32f103c8t6"

if UART_CONSOLE

config UART_STM32_PORT_1
	default y

endif # UART_CONSOLE

endif # BOARD_STM32F103C8T6
```

## samples/application_development/stm32_hunk/sample.yaml
```yaml
sample:
  description: Sample that uses an out-of-tree board
  name: Out-of-tree board
tests:
  boards.out_of_tree:
    tags: out_of_tree
    platform_whitelist: stm32f103c8t6
    harness: console
    harness_config:
      type: one_line
      regex:
        - "Hello World! (.*)"
```
